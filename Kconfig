## Kconfig
```kconfig
#
# For a description of the syntax of this configuration file,
# see Documentation/kbuild/kconfig-language.txt.
#
mainmenu "Linux/$ARCH $KERNELVERSION Kernel Configuration"

config CUSTOM_VERSION
	bool "Use custom kernel version"
	default n
	help
	  This option replaces the kernel version found
	  in Makefile with a custom, user chosen one.

	  If unsure, say N.

config SRCARCH
	string
	option env="SRCARCH"

config ANDROID_VERSION
	string
	option env="ANDROID_VERSION"

config ANDROID_MAJOR_VERSION
	string
	option env="ANDROID_MAJOR_VERSION"

source "arch/$SRCARCH/Kconfig"
```

## security/proca/gaf/Kconfig
```kconfig
# When adding new entries keep the list in alphabetical order
config GAF_V3
	bool "Use GAF structure version 3"
	default y
	help
	  Default option for FIVE-disabled kernel
config GAF_V4
	bool "Use GAF structure version 4"
	default y if FIVE
	help
	  Default option for kernel without PROCA LSM module.
config GAF_V5
	bool "Use GAF structure version 5"
	default y if PROCA
	help
	  Default option for kernel with PROCA 2.0-2.1 LSM module.
config GAF_V6
	bool "Use GAF structure version 6"
	default n
	help
	  Default option for kernel with PROCA 2.2+ LSM module.
```
